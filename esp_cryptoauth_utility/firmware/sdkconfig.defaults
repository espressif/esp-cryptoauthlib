## esp_cryptoauth_utility/firmware/sdkconfig.defaults
```kconfig
CONFIG_ESP_TASK_WDT=n
CONFIG_SPI_FLASH_DANGEROUS_WRITE_ALLOWED=y
CONFIG_ESPTOOLPY_FLASHSIZE_2MB=y
CONFIG_COMPILER_OPTIMIZATION_PERF=y
CONFIG_NEWLIB_NANO_FORMAT=y
CONFIG_ESPTOOLPY_FLASHFREQ_80M=y
CONFIG_ESP32_DEFAULT_CPU_FREQ_240=y
CONFIG_WPA_MBEDTLS_CRYPTO=n
CONFIG_MBEDTLS_TLS_SERVER_AND_CLIENT=n
CONFIG_MBEDTLS_CERTIFICATE_BUNDLE=n
CONFIG_MBEDTLS_SHA512_C=n
CONFIG_MBEDTLS_CCM_C=n
CONFIG_MBEDTLS_TLS_DISABLED=y
CONFIG_MBEDTLS_ASYMMETRIC_CONTENT_LEN=n
CONFIG_MBEDTLS_SSL_KEEP_PEER_CERTIFICATE=n
CONFIG_MBEDTLS_ECP_DP_SECP192R1_ENABLED=n
CONFIG_MBEDTLS_ECP_DP_SECP224R1_ENABLED=n
CONFIG_MBEDTLS_ECP_DP_SECP384R1_ENABLED=n
CONFIG_MBEDTLS_ECP_DP_SECP521R1_ENABLED=n
CONFIG_MBEDTLS_ECP_DP_SECP192K1_ENABLED=n
CONFIG_MBEDTLS_ECP_DP_SECP224K1_ENABLED=n
CONFIG_MBEDTLS_ECP_DP_BP384R1_ENABLED=n
CONFIG_MBEDTLS_ECP_DP_BP512R1_ENABLED=n
CONFIG_MBEDTLS_ECP_DP_CURVE25519_ENABLED=n
CONFIG_MBEDTLS_ECP_DP_BP256R1_ENABLED=n
CONFIG_MBEDTLS_ECP_DP_SECP256K1_ENABLED=n
CONFIG_APP_BUILD_TYPE_ELF_RAM=y
```

## esp_cryptoauth_utility/firmware/sdkconfig.defaults.esp32
```kconfig
CONFIG_ESP32_DEFAULT_CPU_FREQ_240=y
# Following option is only applicable for esp32
CONFIG_ESP_SYSTEM_ESP32_SRAM1_REGION_AS_IRAM=y
```

## esp_cryptoauth_utility/firmware/sdkconfig.defaults.esp32p4
```kconfig
CONFIG_COMPILER_OPTIMIZATION_SIZE=y
CONFIG_COMPILER_OPTIMIZATION_ASSERTIONS_DISABLE=y
CONFIG_APP_BUILD_TYPE_PURE_RAM_APP=y
CONFIG_ESP_CONSOLE_USB_SERIAL_JTAG=y
CONFIG_MBEDTLS_HARDWARE_SHA=n
```
